## config/boards/shields/teenspirit/teenspirit_defconfig
```kconfig
# For audio buzzer
CONFIG_PWM=y
# https://discord.com/channels/939959680611020840/1189280494001606657/1246715087549628417
CONFIG_PWM_INIT_PRIORITY=20

# Turn on logging, and set ZMK logging to debug output
CONFIG_ZMK_USB_LOGGING=y
CONFIG_LOG_PROCESS_THREAD_STARTUP_DELAY_MS=8000
```
