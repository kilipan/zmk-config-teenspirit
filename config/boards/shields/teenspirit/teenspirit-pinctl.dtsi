// for buzzer, copied from sadek baroudi:
// https://github.com/sadekbaroudi/zmk-fingerpunch-keyboards/blob/main/boards/arm/vulpes_majora_v1/vulpes_majora_v1-pinctl.dtsi

#include <dt-bindings/pinctrl/rpi-pico-rp2040-pinctrl.h>

&pinctrl {
    pwm_ch5a_default: pwm_ch5a_default {
        group1 {
            pinmux = <PWM_5A_P26>;
        };
		// group2 {
		//     pinmux = <PWM_6A_P28>;
		// };
    };
};
